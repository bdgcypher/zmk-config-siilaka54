## config/west.yml
```yaml
manifest:
    defaults:
        revision: v0.3
    remotes:
        - name: zmkfirmware
          url-base: https://github.com/zmkfirmware
        # Additional modules containing boards/shields/custom code can be listed here as well
        # See https://docs.zephyrproject.org/3.2.0/develop/west/manifest.html#projects
        - name: m165437 #modded nice!view display
          url-base: https://github.com/M165437
    projects:
        - name: zmk
          remote: zmkfirmware
          import: app/west.yml
        - name: nice-view-gem #modded nice!view display
          remote: m165437 #modded nice!view display
          revision: main #modded nice!view display
    self:
        path: config
```
